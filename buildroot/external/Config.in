## buildroot/external/Config.in
```kconfig
source "$BR2_EXTERNAL_RPI4_USBDAC_PATH/package/audioctl/Config.in"
source "$BR2_EXTERNAL_RPI4_USBDAC_PATH/package/roonbridge/Config.in"
```

## buildroot/external/configs/rpi4_usbdac_defconfig
```kconfig
BR2_aarch64=y
BR2_cortex_a72=y
BR2_TOOLCHAIN_BUILDROOT_GLIBC=y
BR2_PACKAGE_HOST_LINUX_HEADERS_CUSTOM_6_12=y
BR2_TARGET_GENERIC_HOSTNAME="rpi4-usbdac"
BR2_TARGET_GENERIC_ISSUE="RPi4 USB DAC Player"
BR2_SYSTEM_DHCP="eth0"
BR2_ROOTFS_OVERLAY="$(BR2_EXTERNAL_RPI4_USBDAC_PATH)/board/rpi4-usbdac/rootfs-overlay"
BR2_ROOTFS_POST_BUILD_SCRIPT="board/raspberrypi4-64/post-build.sh"
BR2_ROOTFS_POST_IMAGE_SCRIPT="support/scripts/genimage.sh"
BR2_ROOTFS_POST_SCRIPT_ARGS="-c $(BR2_EXTERNAL_RPI4_USBDAC_PATH)/board/rpi4-usbdac/genimage.cfg"

BR2_LINUX_KERNEL=y
BR2_LINUX_KERNEL_CUSTOM_TARBALL=y
BR2_LINUX_KERNEL_CUSTOM_TARBALL_LOCATION="https://github.com/raspberrypi/linux/archive/a923c1dcd822385aaa82a4388c6a6ad92cbf9280.tar.gz"
BR2_LINUX_KERNEL_DEFCONFIG="bcm2711"
BR2_LINUX_KERNEL_DTS_SUPPORT=y
BR2_LINUX_KERNEL_INTREE_DTS_NAME="broadcom/bcm2711-rpi-4-b"
BR2_LINUX_KERNEL_NEEDS_HOST_OPENSSL=y

BR2_PACKAGE_RPI_FIRMWARE=y
BR2_PACKAGE_RPI_FIRMWARE_VARIANT_PI4=y
BR2_PACKAGE_RPI_FIRMWARE_CONFIG_FILE="$(BR2_EXTERNAL_RPI4_USBDAC_PATH)/board/rpi4-usbdac/config.txt"
BR2_PACKAGE_RPI_FIRMWARE_CMDLINE_FILE="$(BR2_EXTERNAL_RPI4_USBDAC_PATH)/board/rpi4-usbdac/cmdline.txt"

BR2_PACKAGE_ALSA_LIB=y
BR2_PACKAGE_ALSA_UTILS=y
BR2_PACKAGE_ALSA_UTILS_APLAY=y
BR2_PACKAGE_SHAIRPORT_SYNC=y
BR2_PACKAGE_SHAIRPORT_SYNC_ALSA=y
BR2_PACKAGE_AVAHI=y
BR2_PACKAGE_AVAHI_DAEMON=y
BR2_PACKAGE_DBUS=y

BR2_PACKAGE_WPA_SUPPLICANT=y
BR2_PACKAGE_WPA_SUPPLICANT_CLI=y
BR2_PACKAGE_WPA_SUPPLICANT_PASSPHRASE=y
BR2_PACKAGE_IW=y
BR2_PACKAGE_WIRELESS_REGDB=y
BR2_PACKAGE_BRCMFMAC_SDIO_FIRMWARE_RPI=y
BR2_PACKAGE_BRCMFMAC_SDIO_FIRMWARE_RPI_WIFI=y

BR2_PACKAGE_DROPBEAR=y
BR2_PACKAGE_BUSYBOX_SHOW_OTHERS=y
BR2_PACKAGE_AUDIOCTL=y
BR2_PACKAGE_ROONBRIDGE=y
BR2_PACKAGE_ROONBRIDGE_SITE="https://download.roonlabs.net/builds"

BR2_TARGET_ROOTFS_EXT2=y
BR2_TARGET_ROOTFS_EXT2_4=y
BR2_TARGET_ROOTFS_EXT2_SIZE="256M"
BR2_TARGET_ROOTFS_TAR=n
BR2_PACKAGE_HOST_GENIMAGE=y
```

## buildroot/external/package/audioctl/Config.in
```kconfig
config BR2_PACKAGE_AUDIOCTL
	bool "audioctl"
	depends on BR2_PACKAGE_HOST_GO_TARGET_ARCH_SUPPORTS
	select BR2_PACKAGE_HOST_GO
	help
	  Tiny web controller for AirPlay and RoonBridge service control.
```

## buildroot/external/package/roonbridge/Config.in
```kconfig
config BR2_PACKAGE_ROONBRIDGE
	bool "RoonBridge"
	depends on BR2_TOOLCHAIN_USES_GLIBC
	help
	  Install the official RoonBridge binary package.

config BR2_PACKAGE_ROONBRIDGE_SITE
	string "RoonBridge download site"
	depends on BR2_PACKAGE_ROONBRIDGE
	default "https://download.roonlabs.net/builds"
	help
	  Base URL containing RoonBridge_linuxarmv8.tar.bz2.
```
